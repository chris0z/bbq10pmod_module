/dts-v1/;
/plugin/;

/{
	compatible = "brcm,bcm2835";

	fragment@0 {
		target = <&i2c1>;
		__overlay__ {
			/* needed to avoid dtc warning */
			#address-cells =<1>;
			#size-cells =<0>;
			
			bbq10pmod@1f {
				compatible = "arturo182,bbq10pmod";				
				reg = <0x1F>;
				interrupts = <4 2>;			/* high-to-low edge triggered */
				interrupt-parent = <&gpio>;
			};
		};
	};
};
